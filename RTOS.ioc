# file: RTOS.ioc
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Mcu.Family=STM32F4
Mcu.Name=STM32F429ZITx
Mcu.Package=LQFP144
NVIC.PriorityGroup=NVIC_PRIORITYGROUP_4
ProjectManager.HeapSize=0x200
ProjectManager.StackSize=0x400
ProjectManager.TargetToolchain=STM32CubeIDE
RCC.AHBFreq_Value=16000000
RCC.APB1Freq_Value=16000000
RCC.APB2Freq_Value=16000000
RCC.CortexFreq_Value=16000000
RCC.HSE_VALUE=25000000
RCC.HSI_VALUE=16000000
RCC.LSE_VALUE=32768
RCC.SYSCLKFreq_VALUE=16000000
RCC.VCOOutputFreq_Value=192000000
board=custom

// file: Core/Src/main.c
/* USER CODE BEGIN Header */
/**
  ******************************************************************************
  * @file           : main.c
  * @brief          : Main program body
  ******************************************************************************
  * @attention
  *
  * <h2><center>&copy; Copyright (c) 2020 STMicroelectronics.
  * All rights reserved.</center></h2>
  *
  * This software component is licensed by ST under BSD 3-Clause license,
  * the "License"; You may not use this file except in compliance with the
  * License. You may obtain a copy of the License at:
  *                        opensource.org/licenses/BSD-3-Clause
  *
  ******************************************************************************
  */
/* USER CODE END Header */

#include "main.h"
#include "Gpio.h"
#include "Rcc.h"
#include "Common.h"
#include "BaseAddress.h"
#include "List.h"
#include "Irq.h"
#include "Tcb.h"
#include "Scb.h"
#include "Serial.h"
#include "ThreadContext.h"
#include "TimerEvent.h"
#include "Kernel.h"
#include "BlockingQueue.h"
#include "Mutex.h"
#include "Semaphore.h"
/* USER CODE BEGIN Includes */
volatile Tcb * tc2;
volatile Tcb * tc1;
TimerEvent  evt,evt2,evt3;
Mutex mut1;
Mutex * libMutex;
Semaphore sema1;
volatile ThreadContext * thread1;
volatile ThreadContext * deQueueThread;
/* USER CODE END Includes */

/* USER CODE BEGIN PV */
int add2Integers(int a,int b);
void switchThreadContext();
void pushIntoTimerQueue();
void blinkSlowLed();
void blinkFastLed();
void blinkUSBLed();
/* USER CODE END PV */

void SystemClock_Config(void);
static void MX_GPIO_Init(void);

int main(void)
{

  /* MCU Configuration--------------------------------------------------------*/

  /* Reset of all peripherals, Initializes the Flash interface and the Systick. */
  HAL_Init();

  /* Configure the system clock */
  SystemClock_Config();

  /* Initialize all configured peripherals */
  MX_GPIO_Init();
  /* USER CODE BEGIN 2 */
  disableIRQ();
  enableGpioG();
  gpioSetMode(gpioG, PIN_13, GPIO_OUT);
  gpioSetPinSpeed(gpioG,PIN_13,HIGH_SPEED);
  gpioSetMode(gpioG, PIN_14, GPIO_OUT);
  gpioSetPinSpeed(gpioG,PIN_14,HIGH_SPEED);

  enableGpio(PORT_B);
  gpioSetMode(gpioB, PIN_13, GPIO_OUT);
  gpioSetPinSpeed(gpioG,PIN_13,HIGH_SPEED);

  tc1 = tcbCreate(1024 ,blinkSlowLed ,"tc1");
  tc2 = tcbCreate(1024 ,blinkUSBLed ,"tc2");
  kernelInit();
  listAddItemToTail((List*)&readyQueue,(ListItem*)tc1);
  listAddItemToTail((List*)&readyQueue,(ListItem*)tc2);

  initMutex(&mut1);
  initSemaphore(&sema1,0);
  configureUart5();
  enableIRQ();
  /*
  //wk2
  volatile int val = add2Integers(45,10);
  volatile int val1 = val;
  val1 += val;
  */

  /* USER CODE END 2 */

  /* Infinite loop */
  while (1)
  {
	  blinkFastLed();
  }
}

void SystemClock_Config(void)
{
  RCC_OscInitTypeDef RCC_OscInitStruct = {0};
  RCC_ClkInitTypeDef RCC_ClkInitStruct = {0};

  /** Configure the main internal regulator output voltage
  */
  __HAL_RCC_PWR_CLK_ENABLE();
  __HAL_PWR_VOLTAGESCALING_CONFIG(PWR_REGULATOR_VOLTAGE_SCALE3);
  /** Initializes the CPU, AHB and APB busses clocks
  */
  RCC_OscInitStruct.OscillatorType = RCC_OSCILLATORTYPE_HSI;
  RCC_OscInitStruct.HSIState = RCC_HSI_ON;
  RCC_OscInitStruct.HSICalibrationValue = RCC_HSICALIBRATION_DEFAULT;
  RCC_OscInitStruct.PLL.PLLState = RCC_PLL_NONE;
  if (HAL_RCC_OscConfig(&RCC_OscInitStruct) != HAL_OK)
  {
    Error_Handler();
  }
  /** Initializes the CPU, AHB and APB busses clocks
  */
  RCC_ClkInitStruct.ClockType = RCC_CLOCKTYPE_HCLK|RCC_CLOCKTYPE_SYSCLK
                              |RCC_CLOCKTYPE_PCLK1|RCC_CLOCKTYPE_PCLK2;
  RCC_ClkInitStruct.SYSCLKSource = RCC_SYSCLKSOURCE_HSI;
  RCC_ClkInitStruct.AHBCLKDivider = RCC_SYSCLK_DIV1;
  RCC_ClkInitStruct.APB1CLKDivider = RCC_HCLK_DIV1;
  RCC_ClkInitStruct.APB2CLKDivider = RCC_HCLK_DIV1;

  if (HAL_RCC_ClockConfig(&RCC_ClkInitStruct, FLASH_LATENCY_0) != HAL_OK)
  {
    Error_Handler();
  }
}

static void MX_GPIO_Init(void)
{

  /* GPIO Ports Clock Enable */
  __HAL_RCC_GPIOA_CLK_ENABLE();

}

/* USER CODE BEGIN 4 */
/*
void blinkFastLed(){
	while(1){
		//green LED
		gpioToggleBit(gpioG, PIN_13 );
		kernelSleep(&evt,300);
		gpioToggleBit(gpioG, PIN_13 );
		kernelSleep(&evt,300);

	}
}
void blinkSlowLed(){
	while(1){
		//red LED
		gpioToggleBit(gpioG, PIN_14 );
		kernelSleep(&evt2,200);
		gpioToggleBit(gpioG, PIN_14 );
		kernelSleep(&evt2,200);
	}
}

void blinkUSBLed(){
	while(1){
		//green USB LED
		gpioToggleBit(gpioB, PIN_13 );
		kernelSleep(&evt3,100);
		gpioToggleBit(gpioB, PIN_13 );
		kernelSleep(&evt3,100);
	}
}
*/
/*
void blinkFastLed(){
	while(1){
		//green LED
		acquireMutex(&mut1);
		gpioToggleBit(gpioG, PIN_13 );
		kernelSleep(&evt,300);
		gpioToggleBit(gpioG, PIN_13 );
		kernelSleep(&evt,300);
		releaseMutex(&mut1);
		acquireMutex(libMutex);
		serialSend(uart5,"pass mutex test for blinkFastLed  \r\n");
		releaseMutex(libMutex);
		scbSetPendSV();
	}
}
void blinkSlowLed(){
	while(1){
		//red LED
		acquireMutex(&mut1);
		gpioToggleBit(gpioG, PIN_14 );
		kernelSleep(&evt2,200);
		gpioToggleBit(gpioG, PIN_14 );
		kernelSleep(&evt2,200);
		releaseMutex(&mut1);
		acquireMutex(libMutex);
		serialSend(uart5,"pass mutex test for blinkSlowLed  \r\n");
		releaseMutex(libMutex);
		scbSetPendSV();
	}
}

void blinkUSBLed(){
	while(1){
		//green USB LED
		acquireMutex(&mut1);
		gpioToggleBit(gpioB, PIN_13 );
		kernelSleep(&evt3,200);
		gpioToggleBit(gpioB, PIN_13 );
		kernelSleep(&evt3,200);
		releaseMutex(&mut1);
		acquireMutex(libMutex);
		serialSend(uart5,"pass mutex test for blinkUSBLed  \r\n");
		releaseMutex(libMutex);
		scbSetPendSV();
	}
}

*/
//signalling situation

void blinkFastLed(){
	while(1){
		//green LED
		acquireMutex(libMutex);
		serialSend(uart5,"semaphore up on blinkFastLed \r\n");
		releaseMutex(libMutex);
		gpioToggleBit(gpioG, PIN_13 );
		kernelSleep(&evt,300);
		semaphoreUp(&sema1,2);
		gpioToggleBit(gpioG, PIN_13 );
		kernelSleep(&evt,300);
	}
}
void blinkSlowLed(){
	while(1){
		//red LED
		semaphoreDown(&sema1,1);
		acquireMutex(libMutex);
		serialSend(uart5,"sema Pass on blinkSlowLed \r\n");
		releaseMutex(libMutex);
		gpioToggleBit(gpioG, PIN_14 );
		kernelSleep(&evt2,200);
		gpioToggleBit(gpioG, PIN_14 );
		kernelSleep(&evt2,200);
	}
}

void blinkUSBLed(){
	while(1){
		//green USB LED
		semaphoreDown(&sema1,1);
		gpioToggleBit(gpioB, PIN_13 );
		kernelSleep(&evt3,200);
		acquireMutex(libMutex);
		serialSend(uart5,"sema Pass on blinkUSBLed \r\n");
		releaseMutex(libMutex);
		gpioToggleBit(gpioB, PIN_13 );
		kernelSleep(&evt3,200);
	}
}

/* USER CODE END 4 */

void Error_Handler(void)
{
}

/************************ (C) COPYRIGHT STMicroelectronics *****END OF FILE****/
